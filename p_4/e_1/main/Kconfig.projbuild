## p_4/e_1/main/Kconfig.projbuild
```kconfig
menu "App Configuration"
    config APP_PERIOD_MS
        int "ADC Reading Period in ms"
        default 1000
        help
            The period in miliseconds between ADC readings.

    config APP_SAMPLES_PER_READING
        int "Number of ADC Samples per Reading"
        default 32
        help
            The number of ADC samples to take per reading.
endmenu
```

## p_4/e_2/components/distance_sensor/Kconfig.projbuild
```kconfig
menu "Distance Sensor Configuration"
    choice
        prompt "Distance Sensor ADC Unit"
        default DISTANCE_SENSOR_ADC_UNIT_1
        help
            Select the type of distance sensor you are using.

        config DISTANCE_SENSOR_ADC_UNIT_1
            bool "ADC Unit 1"
            help
                Select this option if you are using ADC Unit 1.

        config DISTANCE_SENSOR_ADC_UNIT_2
            bool "ADC Unit 2"
            help
                Select this option if you are using ADC Unit 2.
    
    endchoice

    choice
        prompt "Distance Sensor ADC Attenuation"
        default DISTANCE_SENSOR_ADC_ATTEN_DB_11
        help
            Select the attenuation of the ADC unit you are using.

        config DISTANCE_SENSOR_ADC_ATTEN_DB_0
            bool "0 dB"
            help
                Select this option if you are using 0 dB attenuation.

        config DISTANCE_SENSOR_ADC_ATTEN_DB_2_5
            bool "2.5 dB"
            help
                Select this option if you are using 2.5 dB attenuation.

        config DISTANCE_SENSOR_ADC_ATTEN_DB_6
            bool "6 dB"
            help
                Select this option if you are using 6 dB attenuation.

        config DISTANCE_SENSOR_ADC_ATTEN_DB_11
            bool "11 dB"
            help
                Select this option if you are using 11 dB attenuation.

    endchoice

    choice
        prompt "Distance Sensor ADC Width"
        default DISTANCE_SENSOR_ADC_WIDTH_BIT_12
        help
            Select the width of the ADC unit you are using.

        config DISTANCE_SENSOR_ADC_WIDTH_BIT_9
            bool "9 bit"
            help
                Select this option if you are using 9 bit width.

        config DISTANCE_SENSOR_ADC_WIDTH_BIT_10
            bool "10 bit"
            help
                Select this option if you are using 10 bit width.

        config DISTANCE_SENSOR_ADC_WIDTH_BIT_11
            bool "11 bit"
            help
                Select this option if you are using 11 bit width.

        config DISTANCE_SENSOR_ADC_WIDTH_BIT_12
            bool "12 bit"
            help
                Select this option if you are using 12 bit width.

    endchoice

    config DISTANCE_SENSOR_ADC_VREF_MV
        int "Distance Sensor ADC Vref (mV)"
        default 1100
        help
            Select the Vref of the ADC unit you are using.

    menu "Default Args"
        config DISTANCE_SENSOR_DEFAULT_NAME
            string "Distance Sensor Default Name"
            default "Distance Sensor"
            help
                Select the default name of the distance sensor.

        config DISTANCE_SENSOR_DEFAULT_ADC1_CHANNEL
            int "Distance Sensor Default ADC1 Channel"
            default 0
            range 0 7
            help
                Select the default ADC1 channel of the distance sensor.

        config DISTANCE_SENSOR_DEFAULT_ADC2_CHANNEL
            int "Distance Sensor Default ADC2 Channel"
            default 0
            range 0 9
            help
                Select the default ADC2 channel of the distance sensor.

        config DISTANCE_SENSOR_DEFAULT_PERIOD_MS
            int "Distance Sensor Default Period (ms)"
            default 1000
            help
                Select the default period of the distance sensor.

        config DISTANCE_SENSOR_DEFAULT_SAMPLES
            int "Distance Sensor Default Samples"
            default 32
            help
                Select the default samples of the distance sensor.

        config DISTANCE_SENSOR_DEFAULT_QUEUE_SIZE
            int "Distance Sensor Default Queue Size"
            default 1
            help
                Select the default queue size of the distance sensor.
    endmenu
endmenu
```

## p_4/e_3/components/binary_counter_3b/Kconfig.projbuild
```kconfig
menu "Binary Counter Configuration"
    menu "Default Args"
        config BINARY_COUNTER_3B_DEFAULT_NAME
            string "Binary Counter 3B Default Name"
            default "Binary Counter 3B"
            help
                Select the default name of the binary counter 3B.

        config BINARY_COUNTER_3B_DEFAULT_BIT0_GPIO
            int "Binary Counter 3B Default Bit0"
            default 0
            help
                Select the default bit0 of the binary counter 3B.

        config BINARY_COUNTER_3B_DEFAULT_BIT1_GPIO
            int "Binary Counter 3B Default Bit1"
            default 0
            help
                Select the default bit1 of the binary counter 3B.

        config BINARY_COUNTER_3B_DEFAULT_BIT2_GPIO
            int "Binary Counter 3B Default Bit2"
            default 0
            help
                Select the default bit2 of the binary counter 3B.

        config BINARY_COUNTER_3B_DEFAULT_INITIAL_VALUE
            int "Binary Counter 3B Default Initial Value"
            default 0
            help
                Select the default initial value of the binary counter 3B.
    endmenu
endmenu
```

## p_4/e_3/main/Kconfig.projbuild
```kconfig
menu "App Configuration"
    config DISTANCE_SENSOR_TASK
        bool "Enable Distance Sensor"
        default y
        help
            Enable distance sensor.
            Default is disabled.

    menu "Distance Sensor Configuration"
        depends on DISTANCE_SENSOR_TASK

        config DISTANCE_SENSOR_GPIO_INPUT
            int "GPIO Input Pin"
            default 32
            range 0 39
            help
                Select the GPIO input of the distance sensor.
                Default is GPIO 32 (ADC Channel 4).

        config DISTANCE_SENSOR_SAMPLING_PERIOD_MS
            int "Sampling Period (ms)"
            default 2000
            help
                Select the sampling period of the distance sensor.

        config DISTANCE_SENSOR_SAMPLES_PER_READING
            int "Samples Per Reading"
            default 32
            help
                Select the samples per reading of the distance sensor.

        config DISTANCE_SENSOR_QUEUE_SIZE
            int "Queue Size"
            default 1
            help
                Select the queue size of the distance sensor.
    endmenu

    config HALL_SENSOR_TASK
        bool "Enable Hall Sensor"
        default y
        help
            Enable hall sensor.
            Default is disabled.

    menu "Hall Sensor Configuration"
        depends on HALL_SENSOR_TASK

        config HALL_SENSOR_PERIOD_MS
            int "Period (ms)"
            default 1000
            help
                Select the period of the hall sensor.
    endmenu

    config BINARY_COUNTER_3B_TASK
        bool "Enable Binary Counter (3-bit)"
        default y
        help
            Enable binary counter (3-bit).
            Default is disabled.

    menu "Binary Counter (3-bit) Configuration"
        depends on BINARY_COUNTER_3B_TASK

        config BINARY_COUNTER_3B_GPIO_BIT0
            int "GPIO Pin > Bit 0"
            default 17
            range 0 39
            help
                Select the GPIO pin for bit 0 of the binary counter.
                Default is GPIO 16.
        
        config BINARY_COUNTER_3B_GPIO_BIT1
            int "GPIO Pin > Bit 1"
            default 18
            range 0 39
            help
                Select the GPIO pin for bit 1 of the binary counter.
                Default is GPIO 17.

        config BINARY_COUNTER_3B_GPIO_BIT2
            int "GPIO Pin > Bit 2"
            default 19
            range 0 39
            help
                Select the GPIO pin for bit 2 of the binary counter.
                Default is GPIO 18.

        config BINARY_COUNTER_3B_INITIAL_VALUE
            int "Initial Value"
            default 0
            range 0 7
            help
                Select the initial value of the binary counter.
                Default is 0.

        config BINARY_COUNTER_3B_GPIO_RESET
            int "GPIO Input Pin For Counter Reset"
            default 16
            range 0 39
            help
                Select the GPIO pin for reset of the binary counter.
                Default is GPIO 19.
    endmenu

    config APP_TIMEOUT
        bool "Enable App Timeout"
        default n
        help
            Enable app timeout.
            Default is disabled.

    config APP_TIMEOUT_MS
        depends on APP_TIMEOUT
        int "App Timeout (ms)"
        default 30000
        help
            Select the app timeout.
            Default is 30000 ms.
endmenu
```
