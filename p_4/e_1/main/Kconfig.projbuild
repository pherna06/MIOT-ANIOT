## p_5/e_2/components/si7021_i2c/Kconfig.projbuild
```kconfig
menu "Si7012 I2C Configuration"
    menu "I2C Specs"
        config SI7021_I2C_ADDRESS
            hex "I2C Address"
            default 0x40
            help
                I2C Address. Default is 0x40.

        config SI7021_I2C_MAX_CLOCK_SPEED
            int "Max Clock Speed"
            default 400000
            help
                Max Clock Speed. Default is 400000.

        menu "Command Codes"
            config SI7021_I2C_CMD_MEASURE_RH_HOLD_MASTER
                hex "Measure Relative Humidity, Hold Master Mode"
                default 0xE5
                help
                    Default is 0xE5.

            config SI7021_I2C_CMD_MEASURE_RH_NOHOLD_MASTER
                hex "Measure Relative Humidity, No Hold Master Mode"
                default 0xF5
                help
                    Default is 0xF5.

            config SI7021_I2C_CMD_MEASURE_TEMP_HOLD_MASTER
                hex "Measure Temperature, Hold Master Mode"
                default 0xE3
                help
                    Default is 0xE3.

            config SI7021_I2C_CMD_MEASURE_TEMP_NOHOLD_MASTER
                hex "Measure Temperature, No Hold Master Mode"
                default 0xF3
                help
                    Default is 0xF3.

            config SI7021_I2C_CMD_READ_TEMP_FROM_PREV_RH_MEASUREMENT
                hex "Read Temperature Value from Previous RH Measurement"
                default 0xE0
                help
                    Default is 0xE0.

            config SI7021_I2C_CMD_RESET
                hex "Reset"
                default 0xFE
                help
                    Default is 0xFE.

            config SI7021_I2C_CMD_WRITE_RH_T_USER_REG_1
                hex "Write RH/T User Register 1"
                default 0xE6
                help
                    Default is 0xE6.

            config SI7021_I2C_CMD_READ_RH_T_USER_REG_1
                hex "Read RH/T User Register 1"
                default 0xE7
                help
                    Default is 0xE7.

            config SI7021_I2C_CMD_WRITE_HEATER_CONTROL_REG
                hex "Write Heater Control Register"
                default 0x51
                help
                    Default is 0x51.

            config SI7021_I2C_CMD_READ_HEATER_CONTROL_REG
                hex "Read Heater Control Register"
                default 0x11
                help
                    Default is 0x11.

            config SI7021_I2C_CMD_READ_ELECTRONIC_ID_FIRST_BYTES_A
                hex "Read Electronic ID First Bytes, Part A"
                default 0xFA
                help
                    Default is 0xFA.

            config SI7021_I2C_CMD_READ_ELECTRONIC_ID_FIRST_BYTES_B
                hex "Read Electronic ID First Bytes, Part B"
                default 0x0F
                help
                    Default is 0x0F.

            config SI7021_I2C_CMD_READ_ELECTRONIC_ID_LAST_BYTES_A
                hex "Read Electronic ID Last Bytes, Part A"
                default 0xFC
                help
                    Default is 0xFC.

            config SI7021_I2C_CMD_READ_ELECTRONIC_ID_LAST_BYTES_B
                hex "Read Electronic ID Last Bytes, Part B"
                default 0xC9
                help
                    Default is 0xC9.

            config SI7021_I2C_CMD_READ_FIRMWARE_REVISION_A
                hex "Read Firmware Revision, Part A"
                default 0x84
                help
                    Default is 0x84.

            config SI7021_I2C_CMD_READ_FIRMWARE_REVISION_B
                hex "Read Firmware Revision, Part B"
                default 0xB8
                help
                    Default is 0xB8.
        endmenu
    endmenu


    menu "Default Args for Si7012 I2C Handle"
        config SI7021_I2C_DEFAULT_NAME
            string "Name"
            default "si7021_i2c"
            help
                Default Si7021 I2C Handle name.

        config SI7021_I2C_DEFAULT_I2C_PORT
            int "I2C Port"
            default 0
            range 0 1
            help
                Default Si7021 I2C Port.

        config SI7021_I2C_DEFAULT_I2C_CMD_TIMEOUT_MS
            int "I2C Cmd Timeout (ms)"
            default 2000
            help
                Default Si7021 I2C Cmd Timeout (ms).

        config SI7021_I2C_DEFAULT_I2C_DRIVER_INSTALL_BOOL
            bool "Install I2C Driver"
            default y
            help
                Install Si7021 I2C Driver at handle creation.

        config SI7021_I2C_DEFAULT_I2C_DRIVER_INSTALL
            int
            default 1 if SI7021_I2C_DEFAULT_I2C_DRIVER_INSTALL_BOOL
            default 0

        config SI7021_I2C_DEFAULT_I2C_DRIVER_SET_CONFIG_BOOL
            bool "Set I2C Driver Config" if SI7021_I2C_DEFAULT_I2C_DRIVER_INSTALL_BOOL
            default y
            help
                Set Si7021 I2C Driver Config at handle creation.

        config SI7021_I2C_DEFAULT_I2C_DRIVER_SET_CONFIG
            int
            default 1 if SI7021_I2C_DEFAULT_I2C_DRIVER_SET_CONFIG_BOOL
            default 0

        config SI7021_I2C_DEFAULT_I2C_DRIVER_UNINSTALL_AT_DELETE_BOOL
            bool "Uninstall I2C Driver at handle deletion" if SI7021_I2C_DEFAULT_I2C_DRIVER_INSTALL_BOOL
            default y
            help
                Uninstall Si7021 I2C Driver at handle deletion.

        config SI7021_I2C_DEFAULT_I2C_DRIVER_UNINSTALL_AT_DELETE
            int
            default 1 if SI7021_I2C_DEFAULT_I2C_DRIVER_UNINSTALL_AT_DELETE_BOOL
            default 0

        menu "I2C Driver Config"
            visible if SI7021_I2C_DEFAULT_I2C_DRIVER_SET_CONFIG_BOOL

            config SI7021_I2C_DEFAULT_I2C_DRIVER_CONFIG_SCL_IO
                int "SCL GPIO"
                default 19
                help
                    SCL GPIO.

            config SI7021_I2C_DEFAULT_I2C_DRIVER_CONFIG_SDA_IO
                int "SDA GPIO"
                default 18
                help
                    SDA GPIO.

            config SI7021_I2C_DEFAULT_I2C_DRIVER_CONFIG_SCL_PULLUP_EN_BOOL
                bool "SCL Pullup Enable"
                default y
                help
                    SCL Pullup Enable.

            config SI7021_I2C_DEFAULT_I2C_DRIVER_CONFIG_SCL_PULLUP_EN
                int
                default 1 if SI7021_I2C_DEFAULT_I2C_DRIVER_CONFIG_SCL_PULLUP_EN_BOOL
                default 0

            config SI7021_I2C_DEFAULT_I2C_DRIVER_CONFIG_SDA_PULLUP_EN_BOOL
                bool "SDA Pullup Enable"
                default y
                help
                    SDA Pullup Enable.

            config SI7021_I2C_DEFAULT_I2C_DRIVER_CONFIG_SDA_PULLUP_EN
                int
                default 1 if SI7021_I2C_DEFAULT_I2C_DRIVER_CONFIG_SDA_PULLUP_EN_BOOL
                default 0

            config SI7021_I2C_DEFAULT_I2C_DRIVER_CONFIG_MASTER_CLK_SPEED
                int "Master Clock Speed"
                default 400000
                help
                    Master Clock Speed.
        endmenu
    endmenu

endmenu
```

## p_5/e_3/main/Kconfig.projbuild
```kconfig
menu "App Configuration"
    config APP_DURATION_MS
        int "App Duration (ms)"
        default 180000
        help
            Duration in milliseconds of the application.

    config APP_SI7021_PERIOD_MS
        int "SI7021 Period (ms)"
        default 1000
        help
            Period in milliseconds between SI7021 sensor reads.
endmenu # "App Configuration"
```

## p_5/e_4/components/app_leds/Kconfig.projbuild
```kconfig
menu "App LEDs Configuration"

    config APP_LEDS_BLINK_PERIOD_MS
        int "Blink period (ms)"
        default 250
        help
            This option sets the blink period in milliseconds.

    config APP_LEDS_NUM
        int "Number of LEDs"
        default 6
        range 1 8
        help
          This option sets the number of LEDs that will be used by the
          application.

    config APP_LEDS_GPIO_LED_0
        int "LED 0 GPIO" if APP_LEDS_NUM > 0
        default 32
        range 0 33
        help
            This option sets the GPIO number that will be used by the
            application to control the LED 0.

    config APP_LEDS_GPIO_LED_1
        int "LED 1 GPIO" if APP_LEDS_NUM > 1
        default 33
        range 0 33
        help
            This option sets the GPIO number that will be used by the
            application to control the LED 1.

    config APP_LEDS_GPIO_LED_2
        int "LED 2 GPIO" if APP_LEDS_NUM > 2
        default 25
        range 0 33
        help
            This option sets the GPIO number that will be used by the
            application to control the LED 2.

    config APP_LEDS_GPIO_LED_3
        int "LED 3 GPIO" if APP_LEDS_NUM > 3
        default 26
        range 0 33
        help
            This option sets the GPIO number that will be used by the
            application to control the LED 3.

    config APP_LEDS_GPIO_LED_4
        int "LED 4 GPIO" if APP_LEDS_NUM > 4
        default 27
        range 0 33
        help
            This option sets the GPIO number that will be used by the
            application to control the LED 4.

    config APP_LEDS_GPIO_LED_5
        int "LED 5 GPIO" if APP_LEDS_NUM > 5
        default 14
        range 0 33
        help
            This option sets the GPIO number that will be used by the
            application to control the LED 5.

    config APP_LEDS_GPIO_LED_6
        int "LED 6 GPIO" if APP_LEDS_NUM > 6
        default 12
        range 0 33
        help
            This option sets the GPIO number that will be used by the
            application to control the LED 6.

    config APP_LEDS_GPIO_LED_7
        int "LED 7 GPIO" if APP_LEDS_NUM > 7
        default 13
        range 0 33
        help
            This option sets the GPIO number that will be used by the
            application to control the LED 7.

endmenu
```

## p_5/e_4/main/Kconfig.projbuild
```kconfig
menu "App Configuration"

    config APP_TIMER_PERIOD_MS
        int "Timer Period (ms)"
        default 1000
        help
            Period in milliseconds between timer ticks.
    
    config APP_TIMER_READ_HALL_EVERY
        int "Timer Cycles to Read Hall"
        default 1
        help
            Number of timer cycles between hall sensor reads.

    config APP_TIMER_READ_TEMP_EVERY
        int "Timer Cycles to Read Temp"
        default 2
        help
            Number of timer cycles between temperature sensor reads.

    config APP_TIMER_LOG_READINGS_EVERY
        int "Timer Cycles to Log Readings"
        default 5
        help
            Number of timer cycles between logging readings.
    
    menu "Hall Sampling"
        config APP_HALL_BASE_TIMEOUT_MS
            int "Hall Base Timeout (ms)"
            default 2000
            help
                Time to sample hall sensor to get a baseline mean value.

        config APP_HALL_THRESH
            int "Hall Threshold"
            default 25
            help
                Threshold for hall sensor to trigger blinking LEDs.

    endmenu # "Hall Sampling"

    menu "Temp Sampling"
        config APP_TEMP_BASE_TIMEOUT_MS
            int "Temp Base Timeout (ms)"
            default 2000
            help
                Time to sample temperature sensor to get a baseline mean value.

    endmenu # "Temp Sampling"

endmenu # "App Configuration"
```
